## config/west.yml
```yaml
manifest:
  remotes:
    - name: zmkfirmware
      url-base: https://github.com/zmkfirmware
    - name: sayu-hub
      url-base: https://github.com/sayu-hub
    - name: r-Keys-kbd    # <-- PMW3610
      url-base: https://github.com/r-Keys-kbd
    # - name: sekigon-gonnoc  # <-- PAW3222
    #   url-base: https://github.com/sekigon-gonnoc
    - name: caksoylar  # <-- RGB LED
      url-base: https://github.com/caksoylar  
  projects:
    - name: zmk
      remote: zmkfirmware
      revision: v0.3
      import: app/west.yml
    - name: zmk-pmw3610-driver
      remote: r-Keys-kbd
      revision: main
    # - name: zmk-driver-paw3222
    #   remote: sekigon-gonnoc
    #   revision: main
    - name: zmk-rgbled-widget
      remote: caksoylar
      revision: main
  self:
    path: config
```
